#include <behaviors.dtsi>
#include <dt-bindings/zmk/keys.h>

/ {
  keymap {
    compatible = "zmk,keymap";

    default_layer {
      bindings = <
        &kp LCTRL   /* knapp 0: P0.06 */
        &kp N1      /* knapp 1: P0.08 */
      >;
    };
  };
};
